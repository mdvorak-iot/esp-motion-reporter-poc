## main/Kconfig.projbuild
```kconfig
menu "Application config"
    config APP_DEVICE_NAME
        string "Device name"
        default "Motion_Reporter"
        help
            Default name of the device, used in provisioning and as a hostname.

    config APP_CONTROL_BUTTON_PIN
        int "Control button PIN"
        default 0
        help
            GPIO pin for the control button.

    config APP_CONTROL_BUTTON_PROVISION_MS
        int "Control button provisioning delay in ms"
        default 3000

    config APP_CONTROL_BUTTON_FACTORY_RESET_MS
        int "Control button factory reset delay in ms"
        default 10000

    config APP_SNTP_SERVER
        string "SNTP server"
        default "pool.ntp.org"

    config APP_WEBSOCKET_SERVER_URL
        string "WebSocket server URL"
        default "ws://echo.websocket.org"

    config APP_REPORT_BATCH_SIZE
        int "Report to server every N records"
        default 50
endmenu
```

## sdkconfig.defaults
```kconfig
# Custom partition table
CONFIG_ESPTOOLPY_FLASHSIZE_4MB=y
CONFIG_PARTITION_TABLE_CUSTOM=y
CONFIG_PARTITION_TABLE_CUSTOM_FILENAME="partitions.csv"

# More aggresive timing is needed for MPU9250 to function properly
CONFIG_FREERTOS_HZ=1000

# Enable support for power management
CONFIG_PM_ENABLE=y
CONFIG_PM_DFS_INIT_AUTO=y
CONFIG_ESP32_DEFAULT_CPU_FREQ_80=y

# Disable insecure TLS
CONFIG_MBEDTLS_SSL_PROTO_TLS1=n
CONFIG_MBEDTLS_SSL_PROTO_TLS1_1=n

# Wi-Fi provisioning
CONFIG_WIFI_AUTO_PROV_TYPE_BLE=y
CONFIG_WIFI_AUTO_PROV_TYPE_SOFT_AP=n

# BLE for provisioning
CONFIG_BT_ENABLED=y
CONFIG_BTDM_CTRL_MODE_BLE_ONLY=y
CONFIG_BTDM_CTRL_MODE_BR_EDR_ONLY=n
CONFIG_BTDM_CTRL_MODE_BTDM=n
CONFIG_BT_NIMBLE_ENABLED=y

# Status LED
CONFIG_STATUS_LED_DEFAULT_ENABLE=y
CONFIG_STATUS_LED_DEFAULT_GPIO=2
CONFIG_STATUS_LED_DEFAULT_ON=1
```
